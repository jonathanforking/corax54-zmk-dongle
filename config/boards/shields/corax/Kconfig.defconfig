## config/boards/shields/corax/Kconfig.defconfig
```kconfig
if SHIELD_CORAX_DONGLE

config ZMK_KEYBOARD_NAME
    default "Corax Dongle"

config ZMK_SPLIT_ROLE_CENTRAL
    default y

config ZMK_USB
    default y

endif

if SHIELD_CORAX_LEFT || SHIELD_CORAX_RIGHT || SHIELD_CORAX_DONGLE

config ZMK_SPLIT
    default y

config ZMK_BLE
    default y

endif
```

## config/boards/shields/corax/Kconfig.shield
```kconfig
config SHIELD_CORAX_LEFT
    def_bool $(shields_list_contains,corax_left)

config SHIELD_CORAX_RIGHT
    def_bool $(shields_list_contains,corax_right)

config SHIELD_CORAX_DONGLE
    def_bool $(shields_list_contains,corax_dongle)
```
