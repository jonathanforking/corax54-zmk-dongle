#include "corax.dtsi"

&kscan0 {
    // top to bottom
    row-gpios
        = <&pro_micro 5 (GPIO_ACTIVE_HIGH | GPIO_PULL_DOWN)>  // COL 0 (NUM)
        , <&pro_micro 6 (GPIO_ACTIVE_HIGH | GPIO_PULL_DOWN)>  // COL 1 (UPPER)
        , <&pro_micro 7 (GPIO_ACTIVE_HIGH | GPIO_PULL_DOWN)>  // COL 2 (HOME)
        , <&pro_micro 8 (GPIO_ACTIVE_HIGH | GPIO_PULL_DOWN)>  // COL 3 (LOWER)
        , <&pro_micro 9 (GPIO_ACTIVE_HIGH | GPIO_PULL_DOWN)>  // COL 4 (THUMB + ROT)
        ;

    // left to right    
    col-gpios
        = <&pro_micro 19 GPIO_ACTIVE_HIGH>  // ROW 0 (outer)
        , <&pro_micro 18 GPIO_ACTIVE_HIGH>  // ROW 1 (pinky)
        , <&pro_micro 15 GPIO_ACTIVE_HIGH>  // ROW 2 (ring)
        , <&pro_micro 14 GPIO_ACTIVE_HIGH>  // ROW 3 (middle)
        , <&pro_micro 16 GPIO_ACTIVE_HIGH>  // ROW 4 (index)
        , <&pro_micro 10 GPIO_ACTIVE_HIGH>  // ROW 5 (inner)
        ;
};

&left_encoder {
    a-gpios = <&pro_micro 20 (GPIO_ACTIVE_HIGH | GPIO_PULL_UP)>;
    b-gpios = <&pro_micro 21 (GPIO_ACTIVE_HIGH | GPIO_PULL_UP)>;
    status = "okay";
};
